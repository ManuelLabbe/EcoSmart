## esp32_firmware/main/Kconfig.projbuild
```kconfig
menu "EcoSmart Configuration"

    config ESP_WIFI_SSID
        string "WiFi SSID"
        default "myssid"
        help
            SSID de la red WiFi a la que conectarse.

    config ESP_WIFI_PASSWORD
        string "WiFi Password"
        default "mypassword"
        help
            Contraseña de la red WiFi.

    config ESP_MAXIMUM_RETRY
        int "WiFi max retries"
        default 5

    config AWS_IOT_ENDPOINT
        string "AWS IoT Core endpoint"
        default "xxxxxxxxxxxx-ats.iot.us-east-1.amazonaws.com"
        help
            Host del endpoint MQTT de AWS IoT Core (sin https://).

    config AWS_IOT_PORT
        int "AWS IoT Core MQTT port"
        default 8883

    config DEVICE_ID
        string "Device ID"
        default "esp32-mach-001"
        help
            Identificador del dispositivo publicado en el payload JSON.

    config SENSOR_INTERVAL_MS
        int "Sensor publish interval (ms)"
        default 5000
        help
            Intervalo en milisegundos entre lecturas de sensores.

endmenu
```

## esp32_firmware/sdkconfig.defaults
```kconfig
# WiFi
CONFIG_ESP_WIFI_SSID="TU_SSID"
CONFIG_ESP_WIFI_PASSWORD="TU_PASSWORD"
CONFIG_ESP_MAXIMUM_RETRY=5

# AWS IoT Core endpoint (sin https://, solo el host)
CONFIG_AWS_IOT_ENDPOINT="xxxxxxxxxxxx-ats.iot.us-east-1.amazonaws.com"
CONFIG_AWS_IOT_PORT=8883
CONFIG_DEVICE_ID="esp32-mach-001"

# Sensor publish interval en ms
CONFIG_SENSOR_INTERVAL_MS=5000

# Stack y logging
CONFIG_MQTT_TASK_STACK_SIZE=8192
CONFIG_LOG_DEFAULT_LEVEL_INFO=y

# mbedTLS — necesario para TLS con AWS
CONFIG_MBEDTLS_CERTIFICATE_BUNDLE=y
CONFIG_MBEDTLS_SSL_MAX_CONTENT_LEN=16384
```

## esp32_firmware/sdkconfig.defaults.example
```kconfig
# Copiar a sdkconfig.defaults y completar con valores reales
# Este archivo NO contiene credenciales reales

# WiFi
CONFIG_ESP_WIFI_SSID="tu_red_wifi"
CONFIG_ESP_WIFI_PASSWORD="tu_password_wifi"
CONFIG_ESP_MAXIMUM_RETRY=5

# AWS IoT Core endpoint (obtener con: aws iot describe-endpoint --endpoint-type iot:Data-ATS)
CONFIG_AWS_IOT_ENDPOINT="xxxxxxxxxx-ats.iot.us-east-1.amazonaws.com"
CONFIG_AWS_IOT_PORT=8883
CONFIG_DEVICE_ID="esp32-mach-001"

# Sensor publish interval en ms
CONFIG_SENSOR_INTERVAL_MS=5000

# Stack y logging
CONFIG_MQTT_TASK_STACK_SIZE=8192
CONFIG_LOG_DEFAULT_LEVEL_INFO=y

# mbedTLS — necesario para TLS con AWS
CONFIG_MBEDTLS_CERTIFICATE_BUNDLE=y
CONFIG_MBEDTLS_SSL_MAX_CONTENT_LEN=16384
CONFIG_PARTITION_TABLE_CUSTOM=y
CONFIG_PARTITION_TABLE_CUSTOM_FILENAME="partitions.csv"
CONFIG_ESPTOOLPY_FLASHSIZE_8MB=y
CONFIG_ESPTOOLPY_FLASHSIZE="8MB"
CONFIG_ESP_MAIN_TASK_STACK_SIZE=32768
```
